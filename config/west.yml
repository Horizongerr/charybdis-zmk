## config/west.yml
```yaml
manifest:
  remotes:
    - name: zmk
      url-base: https://github.com/zmkfirmware
    - name: badjeff
      url-base: https://github.com/badjeff
    - name: urob
      url-base: https://github.com/urob
    - name: nickcoutsos
      url-base: https://github.com/nickcoutsos
  projects:
    - name: zmk
      remote: zmk
      revision: main
      import: app/west.yml
    - name: zmk-pmw3610-driver
      remote: badjeff
      revision: main
    - name: zmk-helpers
      remote: urob
      revision: main
    - name: zmk-tri-state
      remote: nickcoutsos
      revision: main
  self:
    path: config
```
